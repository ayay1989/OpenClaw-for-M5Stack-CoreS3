## main/Kconfig.projbuild
```kconfig
menu "OpenClaw Stackchan"

    config OPENCLAW_WIFI_SSID
        string "WiFi SSID"
        default "YOUR_WIFI_SSID"
        help
            WiFi SSID used by the firmware. Override locally with idf.py menuconfig
            or sdkconfig before building.

    config OPENCLAW_WIFI_PASSWORD
        string "WiFi password"
        default "YOUR_WIFI_PASSWORD"
        help
            WiFi password used by the firmware. Do not commit real credentials.

    config OPENCLAW_TCP_HOST
        string "OpenClaw TCP host"
        default "192.168.1.100"
        help
            IPv4 address of the Windows/OpenClaw bridge on the same LAN.
            Do not use 127.0.0.1 because it points to the CoreS3 itself.

    config OPENCLAW_TCP_PORT
        int "OpenClaw TCP port"
        default 8765
        range 1 65535

    config OPENCLAW_AUDIO_ENABLE
        bool "Enable experimental CoreS3 speaker output"
        default n
        help
            Enables experimental I2S0 TX for the CoreS3 AW88298 speaker path.
            This is off by default and only intended for local speaker
            validation.

    config OPENCLAW_AUDIO_USE_GPIO0_MCLK
        bool "Use GPIO0 as audio MCLK and disable Button C"
        depends on OPENCLAW_AUDIO_ENABLE
        default n
        help
            Stackchan-HtSz routes AW88298 MCLK to GPIO0. GPIO0 is also the
            ESP32-S3 BOOT pin and this firmware's Button C input, so leave this
            off unless the speaker path requires MCLK during hardware testing.

endmenu
```

## sdkconfig.defaults
```kconfig
CONFIG_IDF_TARGET="esp32s3"
CONFIG_ESP32S3_DEFAULT_CPU_FREQ_240=y
CONFIG_SPIRAM=y
CONFIG_ESP32S3_SPIRAM_SUPPORT=y
CONFIG_ESP32S3_PSRAM_MODE_OCT=y
CONFIG_SPIRAM_MODE_OCT=y
CONFIG_SPIRAM_SPEED_80M=y
CONFIG_SPIRAM_IGNORE_NOTFOUND=y
CONFIG_PARTITION_TABLE_SINGLE_APP_LARGE=y
CONFIG_ESPTOOLPY_FLASHSIZE_16MB=y
CONFIG_ESP_MAIN_TASK_STACK_SIZE=8192
CONFIG_FREERTOS_HZ=1000
CONFIG_LOG_DEFAULT_LEVEL_INFO=y
CONFIG_ESP_CONSOLE_USB_SERIAL_JTAG=y

CONFIG_OPENCLAW_WIFI_SSID="YOUR_WIFI_SSID"
CONFIG_OPENCLAW_WIFI_PASSWORD="YOUR_WIFI_PASSWORD"
CONFIG_OPENCLAW_TCP_HOST="192.168.1.100"
CONFIG_OPENCLAW_TCP_PORT=8765
```
